#include <Wire.h>
#include <Adafruit_GFX.h>
#include <Adafruit_SSD1306.h>
#include <WiFi.h>
#include <WiFiClient.h>
#include <WiFiManager.h>


#define BLYNK_TEMPLATE_ID "TMPL2-GenTvVt"
#define BLYNK_TEMPLATE_NAME "OvenEye"
#define BLYNK_AUTH_TOKEN "###############"
#include <BlynkSimpleEsp32.h>


#define SCREEN_WIDTH 128
#define SCREEN_HEIGHT 64
#define USER_BUTTON  19

Adafruit_SSD1306 display(SCREEN_WIDTH, SCREEN_HEIGHT, &Wire, -1);

int hallPin = 23; 
int buzzPin = 26;

int lastHallReading = HIGH;

unsigned long debounceDuration = 50; // millis
unsigned long buttonHeldTimeLimit = 3000; // millis
unsigned long screenDelayTime = 600; //millis
unsigned long buzzDelayTime = 120; //millis
unsigned long wifiPortalTimeout = 180; //secs
unsigned long wifiStatusScreenTime = 1000; //millis
unsigned long lastTimeButtonStateChanged = 0;
bool wasPressed = false;


/* ---------- LOGO ---------- */
const uint8_t image_data[] PROGMEM = {
0xff, 0xff, 0xff, 0xff, 0xff, 0xff, 0xff, 0xff, 0xff, 0xff, 0xff, 0xff, 0xff, 0xff, 0xff, 0xff, 
0xff, 0xff, 0xff, 0xff, 0xff, 0xff, 0xff, 0xff, 0xff, 0xff, 0xff, 0xff, 0xff, 0xff, 0xff, 0xff, 
0xff, 0xff, 0xff, 0xff, 0xff, 0xff, 0xff, 0xff, 0xff, 0xff, 0xff, 0xff, 0xff, 0xff, 0xff, 0xff, 
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0xff, 0xff, 0xff, 0xff, 0xff, 0xff, 0xff, 0xff, 0xff, 0xff, 0xff, 0xff, 0xff, 0xff, 0xff, 0xff, 
};

WiFiManager wm;


/* ---------- SETUP ---------- */
void setup() {
  Serial.begin(9600);
  Wire.begin(21, 22);

  //Different Sensor I/O configuration
  pinMode(hallPin, INPUT_PULLUP);
  pinMode(USER_BUTTON, INPUT_PULLUP);
  pinMode(buzzPin, OUTPUT);

  /*Disable bluetooth*/
  btStop(); 

  //Wifi                   
  WiFi.setSleep(true);           
  WiFi.persistent(false);        

  //Display
  display.begin(SSD1306_SWITCHCAPVCC, 0x3C);
  

  // Show logo first
  display.clearDisplay();
  display.drawBitmap(0, 0, image_data, 128, 64, WHITE);
  display.display();
  delay(screenDelayTime);

  // Show wifi setup screen
  showInstructions();
  delay(screenDelayTime);

  //Wifi Configuration Screen
  wm.resetSettings();
  wm.setTitle("OvenEye-Setup");
  wm.setConfigPortalTimeout(wifiPortalTimeout);
  if (!wm.autoConnect("OvenEye-Setup")) {
    wm.startConfigPortal("OvenEye-Setup");
  }

  //Blynk Setup
  Blynk.config(BLYNK_AUTH_TOKEN);
  Blynk.connect();
  
}

/* ---------- LOOP ---------- */
void loop() {
  Blynk.run();
  checkWifiResetButton();
  sendStatusToBlynkAndBuzzer();
  showStoveScreen();
}

void sendStatusToBlynkAndBuzzer() {
  Serial.println("sendStatusToBlynkAndBuzzer");
  int reading = digitalRead(hallPin);
  if (reading != lastHallReading) {
    lastHallReading = reading;

    String blynkOvenStatus = (reading == LOW) ? "Off" : "On";
    Blynk.virtualWrite(V1, blynkOvenStatus);
   
    buzzer();
  }
}

void checkWifiResetButton() {
  bool pressed = digitalRead(USER_BUTTON) == LOW;

  if(pressed) {
    if(!wasPressed) {
      lastTimeButtonStateChanged = millis();
      wasPressed = true;
    }
    
  } else {
    if(wasPressed) {
      unsigned long buttonHeldTime = millis() - lastTimeButtonStateChanged;

      if(buttonHeldTime > debounceDuration) {
        if(buttonHeldTime >=  buttonHeldTimeLimit) {
          showInstructions();
          delay(screenDelayTime);
          wm.resetSettings();
          wm.startConfigPortal("OvenEye-Setup");
        } else {
          Serial.println("Show wifi status");
          showWiFiInfo();
          delay(wifiStatusScreenTime);
        }
      }

      wasPressed = false;

    }

  }

}

void buzzer() {
  digitalWrite(buzzPin, HIGH);
  delay(buzzDelayTime);
  digitalWrite(buzzPin, LOW);
}



/* ---------- SCREENS ---------- */
void showInstructions() {
  display.clearDisplay();
  display.setTextSize(1);
  display.setTextColor(WHITE);
  display.setCursor(0, 0);
  display.println("OVENEYE SETUP");
  display.println();
  display.println("1. Connect to");
  display.println("   OvenEye-Setup");
  display.println("2. Follow phone");
  display.println("   prompts");
  display.display();
}

// Display Stove Status 
void showStoveScreen() {
  Serial.println("showStoveScreen");
  display.clearDisplay();
  display.setTextSize(2);
  display.setCursor(0, 20);
  display.print("Stove ");
  display.print(digitalRead(hallPin) == LOW ? "Off" : "On");
  drawWiFiBars(105, 0);
  display.display();
}

/* ---------- WIFI BARS ---------- */
void drawWiFiBars(int x, int y) {
  if (WiFi.status() != WL_CONNECTED) return;
  int rssi = WiFi.RSSI();
  int bars = 0;
  if (rssi >= -55) bars = 4;
  else if (rssi >= -65) bars = 3;
  else if (rssi >= -75) bars = 2;
  else if (rssi >= -85) bars = 1;

  display.fillRect(x, y, 18, 8, BLACK);
  for (int i = 0; i < bars; i++) {
    display.fillRect(x + i * 4, y + (8 - (i + 1) * 2), 3, (i + 1) * 2, WHITE);
  }
}

void showWiFiInfo() {
  display.clearDisplay();
  display.setTextSize(1);
  display.setCursor(0, 0);
  display.println("WiFi Info");
  display.println();
  display.print("SSID: ");
  display.println(WiFi.SSID());
  display.print("IP: ");
  display.println(WiFi.localIP());
  display.print("RSSI: ");
  display.println(WiFi.RSSI());
  display.println();
  display.println("Press to exit");
  display.display();
}


